## lib/cros_config/Kconfig
```kconfig
#
# cros_config configuration
#

config CROS_CONFIG
	bool "Embed Chrome OS master configuration"
	help
	  Enable access to Chrome OS master configuration. This causes mosys
	  to embed the configuration within itself so that it can use it to
	  decode SKU ID and other tasks. This is for use with unified builds.
```

## tests/Kconfig
```kconfig
config TEST
	bool "Enable building the simple test"
	help
	  This test checks that cros_config works correctly. It is intended to
	  be executed by the Chrome OS ebuild, whereas the existing tests
	  do not work in that environment.
```
